## drivers/input/fingerprint/Kconfig
```kconfig
#
# Fingerprint driver configuration
#
menuconfig INPUT_FINGERPRINT
	bool "Fingerprints"
	help
	  Say Y here, and a list of supported fingerprints will be displayed.
	  This option doesn't affect the kernel.

	  If unsure, say Y.

if INPUT_FINGERPRINT

source "drivers/input/fingerprint/fingerprint_detect/Kconfig"

config INPUT_FPC1020
	tristate "FPC 1020 Driver"
	depends on SPI_MASTER

source "drivers/input/fingerprint/goodix_fp/Kconfig"

endif
```

## drivers/input/fingerprint/fingerprint_detect/Kconfig
```kconfig
config INPUT_FINGERPRINT_DETECT
	tristate "Fingerprint Detect Driver"
	depends on SPI_MASTER
```

## drivers/input/touchscreen/synaptics_s3320/Kconfig
```kconfig
config TOUCHSCREEN_SYNAPTICS_S3320_I2C
	tristate "Synaptics S3320 I2C Driver"
	depends on I2C
```

## drivers/power/supply/Kconfig
```kconfig
if BOARD_ONEPLUS5
source "drivers/power/supply/oneplus/Kconfig"
endif

if !BOARD_ONEPLUS5
source "drivers/power/supply/qcom/Kconfig"
endif
```
